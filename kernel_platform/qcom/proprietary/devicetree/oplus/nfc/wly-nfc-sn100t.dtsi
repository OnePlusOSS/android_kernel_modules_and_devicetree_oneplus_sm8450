/**********************************************************************************
* Copyright (c)  2008-2020  Guangdong oplus Mobile Comm Corp., Ltd
* Description: oplus sn100t nfc dtsi
*
* Version: 1.0
* Date: 2021-06-24
* Author: LiuWenJie
*
* ------------------------------ Revision History: --------------------------------
* <version>           <date>                <author>                            <desc>
* Revision 1.0       2021-06-24            LiuWenJie           Created for wyl-nfc-sn100t.dtsi
***********************************************************************************/
&soc {
	//add for nfc_chipset
	nfc_chipset {
		compatible = "oplus-nfc-chipset";
		chipset-20846 = "SN100T";//China
		chipset-20847 = "SN100T";//Europe
		chipset-20848 = "SN100T";//india
		chipset-20849 = "SN100T";//USA
		chipset-2084A = "SN100T";//TMO
	};
};



