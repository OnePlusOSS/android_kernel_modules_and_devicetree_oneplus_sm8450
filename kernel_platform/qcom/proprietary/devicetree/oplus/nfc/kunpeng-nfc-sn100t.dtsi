/**********************************************************************************
* Copyright (c)  2008-2021  Guangdong oplus Mobile Comm Corp., Ltd
* Description: oplus sn100t nfc dtsi
*
* Version: 1.0
* Date: 2021-06-24
* Author: LiuWenJie
*
* ------------------------------ Revision History: --------------------------------
* <version>           <date>                <author>                            <desc>
* Revision 1.0       2021-06-24            LiuWenJie           Created for baize-nfc-sn100t.dtsi
* Revision 1.1       2021-11-30            AericLin            Clone from baize-nfc-sn100t.dtsi to kunpeng-nfc-sn100t.dtsi
***********************************************************************************/
&soc {
	//add for nfc_chipset
	nfc_chipset {
		compatible = "oplus-nfc-chipset";
		chipset-21009 = "SN100T";//China
		chipset-21209 = "SN100T";//Over-sea
	};
};



