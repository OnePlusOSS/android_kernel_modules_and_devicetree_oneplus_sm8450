/**********************************************************************************
* Copyright (c)  2008-2020  Guangdong oplus Mobile Comm Corp., Ltd
* Description: oplus sn100t nfc dtsi
*
* Version: 1.0
* Date: 2021-06-24
* Author: LiuWenJie
*
* ------------------------------ Revision History: --------------------------------
* <version>           <date>                <author>                            <desc>
* Revision 1.0       2021-06-24            Longzuming           Created for ferrari-nfc-sn100t.dtsi
***********************************************************************************/
&soc {
	//add for nfc_chipset
	nfc_chipset {
		compatible = "oplus-nfc-chipset";
		chipset-21631 = "SN100T";//China
		chipset-216AC = "SN100T";//Oversea
	};
};



