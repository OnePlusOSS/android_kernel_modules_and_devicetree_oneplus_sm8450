/dts-v1/;

#include "ravelin.dtsi"
#include "ravelin-cdp.dtsi"

/ {
	model = "Qualcomm Technologies, Inc. Ravelin CDP";
	compatible = "qcom,ravelin-cdp", "qcom,ravelin", "qcom,cdp";
	qcom,board-id = <0x10001 0>;
};

