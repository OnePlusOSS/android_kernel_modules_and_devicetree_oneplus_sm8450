/dts-v1/;
/plugin/;

#include "ravelin-cdp.dtsi"

/ {
	model = "Qualcomm Technologies, Inc. Ravelin CDP";
	compatible = "qcom,ravelin-cdp", "qcom,ravelin", "qcom,cdp";
	qcom,msm-id = <568 0x10000>;
	qcom,board-id = <0x10001 0>;
};

