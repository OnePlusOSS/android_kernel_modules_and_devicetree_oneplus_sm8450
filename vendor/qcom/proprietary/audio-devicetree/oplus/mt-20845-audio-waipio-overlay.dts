/dts-v1/;
/plugin/;
#include <dt-bindings/oplus/hw-id.h>
#include "../waipio-audio-mtp.dts"
#include "waipio_audio_overlay_common.dtsi"
#include "mt_20845_audio_overlay_common.dtsi"
/ {
    oplus,project-id = <20845 0x2084b 0x2084d 0x2084e>;
    oplus,hw-id = <OPLUS_PRE_EVB1 OPLUS_EVB1 OPLUS_T0 OPLUS_EVT1 OPLUS_EVT2 OPLUS_DVT1 OPLUS_PVT1>;
};
