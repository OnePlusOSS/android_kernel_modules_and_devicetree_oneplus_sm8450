/dts-v1/;
/plugin/;
#include <dt-bindings/oplus/hw-id.h>
#include "../cape-audio-mtp.dts"
#include "cape_audio_overlay_common.dtsi"
#include "lvzhou_22015_audio_overlay_common.dtsi"
/ {
        oplus,project-id = <22015 22214>;
        oplus,hw-id = <OPLUS_EVB1 OPLUS_T0 OPLUS_EVT1 OPLUS_EVT2 OPLUS_DVT1 OPLUS_PVT1 OPLUS_MP1>;
};
