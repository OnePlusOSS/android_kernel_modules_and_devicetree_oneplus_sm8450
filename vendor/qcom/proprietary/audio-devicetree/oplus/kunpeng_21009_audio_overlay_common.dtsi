/* #ifdef OPLUS_ARCH_EXTENDS */
&wcd938x_codec {
	qcom,cdc-micbias1-mv = <2700>;
	qcom,cdc-micbias2-mv = <2700>;
	qcom,cdc-micbias3-mv = <2700>;
	qcom,cdc-micbias4-mv = <2700>;
};
/* OPLUS_ARCH_EXTENDS */
