/dts-v1/;
/plugin/;
#include <dt-bindings/oplus/hw-id.h>
#include "../waipio-audio-mtp.dts"
#include "waipio_audio_overlay_common.dtsi"
#include "kunpeng_21009_audio_overlay_common.dtsi"
/ {
    oplus,project-id = <21009>;
    oplus,hw-id = <OPLUS_EVB1 OPLUS_T0 OPLUS_EVT1 OPLUS_EVT2 OPLUS_DVT1 OPLUS_PVT1 OPLUS_MP1>;
};
