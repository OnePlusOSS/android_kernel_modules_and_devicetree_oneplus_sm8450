/dts-v1/;
/plugin/;

#include <dt-bindings/clock/qcom,gcc-waipio.h>
#include <dt-bindings/clock/qcom,camcc-waipio.h>
#include <dt-bindings/interconnect/qcom,waipio.h>
#include <dt-bindings/interrupt-controller/arm-gic.h>
#include <dt-bindings/regulator/qcom,rpmh-regulator-levels.h>

#include <dt-bindings/oplus/hw-id.h>
//#include "../waipio-camera-sensor-mtp.dts"
#include "waipio_camera_overlay_common.dtsi"
#include "daoxiang_23023_camera_overlay_common.dtsi"
/ {
    model = "Qualcomm Technologies, Inc. Waipio MTP, Daoxiang";
    compatible = "qcom,waipio", "qcom,waipio";
    oplus,project-id = <23023>;
    oplus,hw-id = <OPLUS_EVT1 OPLUS_EVT2 OPLUS_DVT1 OPLUS_DVT2 OPLUS_PVT1 OPLUS_PVT2 OPLUS_MP1 OPLUS_MP2>;
};
