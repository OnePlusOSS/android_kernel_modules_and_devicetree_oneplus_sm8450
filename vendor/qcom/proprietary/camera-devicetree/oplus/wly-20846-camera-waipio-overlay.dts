/dts-v1/;
/plugin/;

#include <dt-bindings/clock/qcom,gcc-waipio.h>
#include <dt-bindings/clock/qcom,camcc-waipio.h>
#include <dt-bindings/interconnect/qcom,waipio.h>
#include <dt-bindings/interrupt-controller/arm-gic.h>
#include <dt-bindings/regulator/qcom,rpmh-regulator-levels.h>

#include <dt-bindings/oplus/hw-id.h>
/* #include "../waipio-camera-sensor-mtp.dts" */
#include "waipio_camera_overlay_common.dtsi"
#include "wly_20846_camera_overlay_common.dtsi"
/ {
    model = "Qualcomm Technologies, Inc. Waipio MTP, WLY";
    compatible = "qcom,waipio", "qcom,waipiop";
    qcom,msm-id = <457 0x10000>, <482 0x10000>, <457 0x20000>, <482 0x20000>, <552 0x10000>;
    qcom,board-id = <8 0>, <0x10008 0>, <0x02010008 0>, <0x03010008 0x03>, <0x04010008 0x04>;

    oplus,project-id = <20846 20847 20848 20849 0x2084a>;
    oplus,hw-id = <OPLUS_T0 OPLUS_EVT1 OPLUS_EVT2 OPLUS_DVT1 OPLUS_DVT2 OPLUS_PVT1>;
};
