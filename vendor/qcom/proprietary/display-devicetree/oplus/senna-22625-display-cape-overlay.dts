/dts-v1/;
/plugin/;
#include <dt-bindings/oplus/hw-id.h>
#include "../display/cape-sde-display-mtp-overlay.dts"
#include "senna_22625_display_overlay_common.dtsi"
/* #if defined(CONFIG_PXLW_IRIS) */
#include "../display/pxlw-senna/pxlw-iris5.dtsi"
#include "../display/pxlw-senna/dsi-panel-pxlw.dtsi"
/* #endif */
/ {
    oplus,project-id = <22625 0x226B2 0x226B3>;
//    oplus,hw-id = <OPLUS_EVB1 OPLUS_EVB2 OPLUS_T0 OPLUS_EVT1 OPLUS_EVT2 OPLUS_EVT3 OPLUS_DVT1 OPLUS_DVT2 OPLUS_DVT3 OPLUS_PVT1 OPLUS_MP1 OPLUS_MP2 OPLUS_MP3>;
};
