/dts-v1/;
/plugin/;

#include "cape-sde-display-cdp.dtsi"

/ {
	model = "Qualcomm Technologies, Inc. Cape CDP";
	compatible = "qcom,cape-cdp", "qcom,cape", "qcom,cdp", "qcom,cape-v2-cdp", "qcom,cape-v2";
	qcom,msm-id = <530 0x10000>, <540 0x10000>;
	qcom,board-id = <1 0>;
};
