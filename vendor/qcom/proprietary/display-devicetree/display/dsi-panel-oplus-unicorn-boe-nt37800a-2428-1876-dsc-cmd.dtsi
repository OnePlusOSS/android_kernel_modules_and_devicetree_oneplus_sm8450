&mdss_mdp {
    dsi_oplus_unicorn_boe_nt37800a_2428_1876_cmd: qcom,mdss_dsi_oplus_unicorn_boe_nt37800a_2428_1876_cmd {
        qcom,mdss-dsi-panel-name =
          "boe nt37800a amoled mipi panel with DSC";
        qcom,dsi-ctrl-num = <0>;
        qcom,dsi-phy-num = <0>;
        qcom,dsi-select-clocks = "src_byte_clk0", "src_pixel_clk0";
        qcom,mdss-dsi-panel-type = "dsi_cmd_mode";
        qcom,mdss-dsi-virtual-channel-id = <0>;
        qcom,mdss-dsi-stream = <0>;
        qcom,mdss-dsi-bpp = <24>;
        qcom,mdss-dsi-color-order = "rgb_swap_rgb";
        qcom,mdss-dsi-underflow-color = <0xff>;
        qcom,mdss-dsi-border-color = <0>;

        qcom,mdss-dsi-traffic-mode = "non_burst_sync_event";
        qcom,mdss-dsi-lane-map = "lane_map_0123";
        qcom,mdss-dsi-bllp-eof-power-mode;
        qcom,mdss-dsi-bllp-power-mode;
        qcom,mdss-dsi-lane-0-state;
        qcom,mdss-dsi-lane-1-state;
        qcom,mdss-dsi-lane-2-state;
        qcom,mdss-dsi-lane-3-state;
        qcom,mdss-dsi-dma-trigger = "trigger_sw";
        qcom,mdss-dsi-mdp-trigger = "none";
        qcom,mdss-dsi-reset-sequence = <1 10>, <0 10>, <1 10>;
        qcom,mdss-dsi-te-pin-select = <1>;
        qcom,mdss-dsi-wr-mem-start = <0x2c>;
        qcom,mdss-dsi-wr-mem-continue = <0x3c>;
        qcom,mdss-dsi-te-dcs-command = <1>;
        qcom,mdss-dsi-te-check-enable;
        qcom,mdss-dsi-te-using-te-pin;
        qcom,mdss-dsi-panel-hdr-enabled;
        qcom,mdss-dsi-panel-hdr-color-primaries = <15000 15500 34000
            16000 13250 34500 7500 3000>;
        qcom,mdss-dsi-panel-peak-brightness = <4300000>;
        qcom,mdss-dsi-panel-blackness-level = <1023>;
        //qcom,esd-check-enabled;
        qcom,mdss-dsi-panel-status-check-mode = "reg_read";
        qcom,mdss-dsi-panel-status-command = [06 01 00 01 05 00 02 0A 00];
        qcom,mdss-dsi-panel-status-command-state = "dsi_hs_mode";
        qcom,mdss-dsi-panel-status-value = <0x9C>;
        qcom,mdss-dsi-panel-status-read-length = <1>;
        //qcom,mdss-dsi-panel-orientation = "hflip";

        qcom,mdss-dsi-display-timings {
            timing@0{
                qcom,mdss-dsi-panel-clockrate = <652800000>;
                qcom,mdss-dsi-panel-framerate = <60>; /* 60 FPS */
                qcom,mdss-dsi-panel-width = <2428>;
                qcom,mdss-dsi-panel-height = <1876>;
                qcom,mdss-dsi-h-front-porch = <128>;
                qcom,mdss-dsi-h-back-porch = <128>;
                qcom,mdss-dsi-h-pulse-width = <32>;
                qcom,mdss-dsi-h-sync-skew = <0>;
                qcom,mdss-dsi-h-sync-pulse = <0>;
                qcom,mdss-dsi-v-back-porch = <16>;
                qcom,mdss-dsi-v-front-porch = <32>;
                qcom,mdss-dsi-v-pulse-width = <3>;
                qcom,mdss-dsi-h-left-border = <0>;
                qcom,mdss-dsi-h-right-border = <0>;
                qcom,mdss-dsi-v-top-border = <0>;
                qcom,mdss-dsi-v-bottom-border = <0>;
                qcom,mdss-dsi-panel-jitter = <0x4 0x1>;
        qcom,mdss-dsi-on-command = [
                    39 01 00 00 00 00 06 F0 55 AA 52 00 00
                    39 01 00 00 00 00 05 FF AA 55 A5 80
                    39 01 00 00 00 00 02 6F 50
                    39 01 00 00 00 00 02 FB 00
                    39 01 00 00 00 00 05 FF AA 55 A5 81
                    39 01 00 00 00 00 05 FF AA 55 A5 00
                    39 01 00 00 00 00 01 35
                    39 01 00 00 00 00 05 3B 00 10 00 10
                    39 01 00 00 00 00 02 53 20
                    39 01 00 00 00 00 05 51 04 20 0F FF
                    39 01 00 00 00 00 05 88 06 FD 05 42
                    39 01 00 00 00 00 03 87 0F FF
                    39 01 00 00 00 00 02 03 01
                    39 01 00 00 00 00 05 2A 00 00 09 7B
                    39 01 00 00 00 00 05 2B 00 00 07 53
                    39 01 00 00 00 00 02 90 81
                    39 01 00 00 00 00 13 91 89 28 00 04 02 00 01 00 01 B9 00 10 00 00 0B 25 10 D0
                    39 01 00 00 00 00 01 2C
                    05 01 00 00 78 00 01 11
                    39 01 00 00 0A 00 02 2F 01
                    05 01 00 00 0A 00 01 29
                    ];
        qcom,mdss-dsi-off-command = [
                    05 01 00 00 14 00 01 28
                    05 01 00 00 64 00 01 10
                    ];

        qcom,mdss-dsi-post-backlight = [
                    05 01 00 00 00 00 01 29
                ];
        qcom,mdss-dsi-panel-goa-on = [
                    39 01 00 00 00 00 02 84 02
                ];
        qcom,mdss-dsi-panel-goa-off = [
                    39 01 00 00 00 00 02 84 03
                ];
        qcom,compression-mode = "dsc";
        qcom,mdss-dsc-slice-height = <4>;
        qcom,mdss-dsc-slice-width = <1214>;
        qcom,mdss-dsc-slice-per-pkt = <2>;
        qcom,mdss-dsc-bit-per-component = <8>;
        qcom,mdss-dsc-bit-per-pixel = <8>;
        qcom,mdss-dsc-block-prediction-enable;
            };
        };
    };
};

&dsi_oplus_unicorn_boe_nt37800a_2428_1876_cmd {
    qcom,panel-supply-entries = <&dsi_panel_oplus_unicorn_pwr_supply>;
    qcom,bl-update-flag = "delay_until_first_frame";
    qcom,mdss-dsi-bl-pmic-control-type = "bl_ctrl_dcs";
    qcom,mdss-dsi-bl-min-level = <1>;
    qcom,mdss-dsi-bl-max-level = <1023>;
    qcom,mdss-brightness-max-level = <1023>;
    oplus,dsi-brightness-normal-max-level = <1023>;
    oplus,dsi-brightness-default-level = <400>;
    qcom,platform-te-gpio = <&tlmm 86 0>;
    qcom,platform-reset-gpio = <&tlmm 3 0>;
    qcom,ulps-enabled;
    /* oplus panel goa config */
    oplus,py-panel-goa-support;

    qcom,dsi-select-clocks = "mux_byte_clk0", "mux_pixel_clk0",
                "src_byte_clk0", "src_pixel_clk0",
                "shadow_byte_clk0", "shadow_pixel_clk0";
    qcom,dsi-select-clocks = "mux_byte_clk0", "mux_pixel_clk0";
    qcom,mdss-dsi-t-clk-post = <0x0E>;
    qcom,mdss-dsi-t-clk-pre = <0x35>;
    qcom,mdss-dsi-display-timings {
        timing@0{
            qcom,mdss-dsi-panel-phy-timings = [00 1A 06 06 22 20 07
                06 04 02 04 00 16 16];

            qcom,display-topology = <2 2 1>;
            qcom,default-topology-index = <0>;
        };
    };
};
