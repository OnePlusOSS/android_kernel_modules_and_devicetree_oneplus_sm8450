## vendor/oplus/hardware/radio/mdmrst/common/Kconfig
```kconfig
config OPLUS_FEATURE_RECORD_MDMRST
tristate "config record mdmrst"
  default n
help
    define this config to count the modem restart times.
```

## vendor/oplus/kernel/charger/debug-kit/Kconfig.ddk
```kconfig
config OPLUS_FEATURE_CHG_DEBUG_KIT
	tristate "Charger Debug Kit"
	depends on REGMAP
	default n
	help
	  Say Y or M to enable debug kit
```

## vendor/oplus/kernel/charger/gauge_i2c_rst/Kconfig.ddk
```kconfig
config OPLUS_I2C_RST_NOTIFY
	tristate "gauge i2c reset notify"
	help
	  Say Y or M to enable gauge i2c reset notify
```

## vendor/oplus/kernel/charger/v2/ufcs/Kconfig.ddk
```kconfig
menuconfig OPLUS_UFCS_CLASS
	tristate "oplus ufcs class"
	default n
	help
	  Say Y or M to enable oplus ufcs class

config OPLUS_UFCS_CLASS_DEBUG
	bool "oplus ufcs class debug feature"
	depends on OPLUS_UFCS_CLASS
	default n
	help
	  Say Y to enable oplus ufcs class debug feature
```

## vendor/oplus/kernel/charger/wireless_pen/Kconfig
```kconfig
menuconfig OPLUS_WIRELESS_PEN
	tristate "OPLUS_WIRELESS_PEN_CONFIG"
	default n
	help
	  Say Y or m to include support

if OPLUS_WIRELESS_PEN

config OPLUS_WIRELESS_PEN_CPS8601
	bool "OPLUS_WIRELESS_PEN_CPS8601"
	default n
	depends on OPLUS_WIRELESS_PEN
	help
	  Say Y to include support
endif #OPLUS_WIRELESS_PEN
```

## vendor/oplus/kernel/dfr/Kconfig
```kconfig
# SPDX-License-Identifier: GPL-2.0-only
# Copyright (C) 2018-2022 Oplus. All rights reserved.

#ifdef OPLUS_FEATURE_PMIC_MONITOR
source "drivers/soc/oplus/dfr/qcom/qcom_pmic_monitor/Kconfig"
#endif /* OPLUS_FEATURE_PMIC_MONITOR */

#ifdef OPLUS_FEATURE_FORCE_SHUTDOWN
source "drivers/soc/oplus/dfr/qcom/force_shutdown/Kconfig"
#endif /* OPLUS_FEATURE_FORCE_SHUTDOWN */

#ifdef OPLUS_FEATURE_QCOM_PMICWD
source "drivers/soc/oplus/dfr/qcom/qcom_pmicwd/Kconfig"
#endif /* OPLUS_FEATURE_QCOM_PMICWD */

#ifdef OPLUS_FEATURE_QCOM_WATCHDOG
source "drivers/soc/oplus/dfr/qcom/qcom_watchdog/Kconfig"
#endif /* OPLUS_FEATURE_QCOM_WATCHDOG */

#ifdef OPLUS_FEATURE_DUMP_REASON
source "drivers/soc/oplus/dfr/qcom/dump_device_info/Kconfig"
#endif /* OPLUS_FEATURE_DUMP_REASON */

#ifdef OPLUS_FEATURE_DUMP_REASON
source "drivers/soc/oplus/dfr/qcom/dump_reason/Kconfig"
#endif /* OPLUS_FEATURE_DUMP_REASON */

#ifdef OPLUS_FEATURE_SHUTDOWN_DETECT
source "drivers/soc/oplus/dfr/common/shutdown_detect/Kconfig"
#endif /* OPLUS_FEATURE_SHUTDOWN_DETECT */

#ifdef OPLUS_FEATURE_HUNG_TASK_ENHANCE
source "drivers/soc/oplus/dfr/common/hung_task_enhance/Kconfig"
#endif /* OPLUS_FEATURE_HUNG_TASK_ENHANCE */

#ifdef OPLUS_FEATURE_SAUPWK
source "drivers/soc/oplus/dfr/common/oplus_saupwk/Kconfig"
#endif /* OPLUS_FEATURE_SAUPWK */

#ifdef OPLUS_FEATURE_THEIA
source "drivers/soc/oplus/dfr/common/theia/Kconfig"
#endif /* OPLUS_FEATURE_THEIA */

#ifdef OPLUS_FEATURE_INIT_WATCHDOG
source "drivers/soc/oplus/dfr/common/init_watchdog/Kconfig"
#endif /* OPLUS_FEATURE_INIT_WATCHDOG */

#ifdef OPLUS_FEATURE_KEYEVENT_HANDLER
source "drivers/soc/oplus/dfr/common/keyevent_handler/Kconfig"
#endif /* OPLUS_FEATURE_KEYEVENT_HANDLER */

#ifdef OPLUS_FEATURE_COMBKEY_MONITOR
source "drivers/soc/oplus/dfr/common/combkey_monitor/Kconfig"
#endif /* OPLUS_FEATURE_COMBKEY_MONITOR */

#ifdef CONFIG_OPLUS_FEATURE_FDLEAK_CHECK
source "drivers/soc/oplus/dfr/common/oplus_fdleak/Kconfig"
#endif /*CONFIG_OPLUS_FEATURE_FDLEAK_CHECK*/
```

## vendor/oplus/kernel/mm/dynamic_readahead/Kconfig
```kconfig
config OPLUS_FEATURE_DYNAMIC_READAHEAD
	tristate "dynamic pagecache readahead"
	default n
	help
	  This driver used for dynamically tuning filemap readahead for performance.
```

## vendor/oplus/kernel/mm/kswapd_opt/Kconfig
```kconfig
config OPLUS_FEATURE_KSWAPD_OPT
	tristate "enable oplus kswapd opt feature"
	default n
	help
	  This feature enable some kswapd opt feature. include
	  alloc callsite adjust flags to exclude kswapd_recalim where fallback to low order alloc possible.
	  collect alloc slowpath wakeup kswapd stat by order layout.
	  collect kswapd pgdat_balance workload stat by order layout.
```

## vendor/oplus/kernel/mm/mm_osvelte/Kconfig
```kconfig
config OPLUS_FEATURE_MM_OSVELTE
	tristate "osvelte driver"
	default n
	help
	  This driver used for memory debugging.

config OPLUS_FEATURE_MM_OSVELTE_DBG
	tristate "osvelte driver"
	default n
	help
	  This driver used for memory debugging.
```

## vendor/oplus/kernel/oplus_performance_5.10/misc/sched_input_boost/Kconfig
```kconfig
config OPLUS_FEATURE_INPUT_BOOST
	tristate "input boost"
	default n
	depends on OPLUS_FEATURE_PERFORMANCE_SCHED
	help
	  reduce execution time of heavy threads
```

## vendor/oplus/kernel/storage/common/iolimit/Kconfig
```kconfig
# SPDX-License-Identifier: GPL-2.0-only
#
#

config UNISOC_IOLIMIT
	tristate "vfs io limit support"
	depends on BLK_CGROUP
	help
	Provide a blkio policy implementing for io bandwidth while a process
	in the cgroup buffer write.
```

## vendor/oplus/kernel/touchpanel/oplus_touchscreen_v2/Focal/ft3658u_spi/Kconfig
```kconfig
config TOUCHPANEL_FOCAL_FT3658U_SPI
	tristate "TP focal ft3658U spi IC enable or not for OPLUS"
	help
	say Y to enable driver for Touchpanel using Focal FT3658u spi
```

## vendor/oplus/sensor/kernel/oplus_virtual_sensor/sensors/palm_detecthub/Kconfig
```kconfig
config OPLUS_FEATURE_PALM_DETECT
	bool "palm_detecthub for MediaTek package"
	default n
```
