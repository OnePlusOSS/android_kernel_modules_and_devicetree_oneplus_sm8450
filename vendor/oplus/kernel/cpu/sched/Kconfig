## vendor/oplus/kernel/cpu/sched/Kconfig
```kconfig
# SPDX-License-Identifier: GPL-2.0-only
# Copyright (C) 2018-2020 Oplus. All rights reserved.

config OPLUS_FEATURE_PERFORMANCE_SCHED
	bool "config oplus kernel sched feature"
	default y
	help
	  define this config to add oplus kernel sched feature

config OPLUS_FEATURE_SCHED_ASSIST
	tristate "sched assist"
	default n
	help
	  turning sched for ui, render and so on to improve UX

config OPLUS_FEATURE_SF_BOOST
	tristate "sf boost"
	default n
	help
	  When the util of surfaceflinger is greater than 90,
	  prefer to use big core.

config OPLUS_FEATURE_HEALTHINFO
	tristate "config healthinfo"
	default n
	depends on OPLUS_FEATURE_PERFORMANCE_SCHED
	help
	  define this config to init  healthinfo.

config OPLUS_FEATURE_TASK_CPUSTATS
	tristate "task_cpustats"
	default n
	help
	  record cpu status

config OPLUS_FEATURE_SCHED_SPREAD
	bool "sched spread"
	default n
	depends on OPLUS_FEATURE_SCHED_ASSIST
	depends on CGROUP_SCHED
	help
	  This is the uifirst 5.0 feature, which will spread tasks,
	  kick runnable time from task demand.

config OPLUS_FEATURE_TASK_SCHED
	tristate "task_sched"
	default n
	depends on OPLUS_FEATURE_SCHED_ASSIST
	help
	  record task sched info

config OPLUS_FEATURE_TASK_LOAD
	tristate "task_load"
	default n
	depends on OPLUS_FEATURE_SCHED_ASSIST
	help
	  record cpu and task load

config OPLUS_SCHED_TUNE
	bool "Boosting for CFS tasks (EXPERIMENTAL)"
	default n
	help
	  This option enables support for task classification using a new
	  cgroup controller, schedtune. Schedtune allows tasks to be given
	  a boost value and marked as latency-sensitive or not. This option
	  provides the "schedtune" controller.

	  This new controller:
	  1. allows only a two layers hierarchy, where the root defines the
	     system-wide boost value and its direct childrens define each one a
	     different "class of tasks" to be boosted with a different value
	  2. supports up to 16 different task classes, each one which could be
	     configured with a different boost value

	  Latency-sensitive tasks are not subject to energy-aware wakeup
	  task placement. The boost value assigned to tasks is used to
	  influence task placement and CPU frequency selection (if
	  utilization-driven frequency selection is in use).

	  If unsure, say N.

config OPLUS_FEATURE_LOADBALANCE
	bool "oplus loadbalance"
	default n
	depends on OPLUS_FEATURE_SCHED_ASSIST
	help
	  This is the uifirst 6.0 feature about loadbalance.

config OPLUS_FEATURE_PIPELINE
	bool "oplus pipeline"
	default n
	depends on OPLUS_FEATURE_SCHED_ASSIST
	help
	  hint game critical threads to run on some specific cpus.

config OPLUS_SCHED_MT6895
	bool "mt6895 specific sched feature"
	default n
	help
	  the difference between the mainline currently is whether to
	  skip the CPU where the ux task is located when the RT task
	  selects a new cpu core.
	  rt tasks have "affinity with" prev running cpu, this only
	  takes effect when a new core is selected.

config OPLUS_FEATURE_CPU_JANKINFO
	tristate "config oplus_schedinfo"
	default n
	depends on OPLUS_FEATURE_PERFORMANCE_SCHED
	help
	  define this config to enable oplus_schedinfo.

config OPLUS_FEATURE_FRAME_BOOST
	tristate "frame boost"
	default n
	depends on OPLUS_FEATURE_PERFORMANCE_SCHED
	help
	  This moduler is used to improve frame missing by aggregating key-threads in one group,
	  then adjust cpu frequence and placement.

config OPLUS_CPU_AUDIO_PERF
	tristate "boost audio task in scheduler"
	default n
	help
	   Choose this option to enable scheduler boost for audio task.

config LOCKING_PROTECT
	bool "locking protect"
	depends on OPLUS_FEATURE_SCHED_ASSIST
	default n
	help
	   protect locking protect.

config PCPU_RWSEM_LOCKING_PROTECT
	bool "percpu-rwsem locking protect"
	depends on LOCKING_PROTECT
	default n
	help
	   percpu-rwsem protect locking protect.

config OPLUS_FEATURE_BAN_APP_SET_AFFINITY
	bool "config ban app set affinity"
	default n
	help
	  ban app set affinity

config OPLUS_FEATURE_EAS_OPT
	tristate "eas opt"
	default n
	help
	  control oplus_cap, iowait_protect

config OPLUS_FEATURE_VT_CAP
	tristate "oplus cap"
	default n
	depends on OPLUS_FEATURE_EAS_OPT
	help
	  oplus cap can influence task placement

config OPLUS_CPUFREQ_IOWAIT_PROTECT
	tristate "cpufreq_iowait"
	default n
	depends on OPLUS_FEATURE_EAS_OPT
	help
		ensure iowait decay not happen too quickly

config OPLUS_FEATURE_SKIP_CAMERA_UX
	tristate "skip camera ux tick by node"
	default n
	help
	  Turning off the camera's ux attribute by node

config OPLUS_SCHED_GROUP_OPT
	bool "Oplus sched group optimization"
	depends on FAIR_GROUP_SCHED
	default FAIR_GROUP_SCHED

config OPLUS_FEATURE_QOS_SCHED
	tristate "Qos Level Control for thread"
	default n
	help
	This option allows to apply qos level for thread in scheduler.
```

## vendor/oplus/kernel/dfr/common/kp_freeze_detect/Kconfig
```kconfig
# SPDX-License-Identifier: GPL-2.0-only
# Copyright (C) 2018-2020 Oplus. All rights reserved.
config OPLUS_FEATURE_KP_FREEZE_DETECT
    tristate "KP FREEZE DETECT"
    default n
    help
      define this config to init KP_FREEZE_DETECT .
```
